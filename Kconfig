## Kconfig
```kconfig
comment "MCU Task configure"

config MULTITHREADING
    bool
    default n

choice
    prompt "CPU Endian"
config LITTLE_ENDIAN
    bool "Little Endian"
config BIG_ENDIAN
    bool "Big Endian"
endchoice

source "$BOARD_DIR/Kconfig"
rsource "rtos/Kconfig"
rsource "subsys/Kconfig"
rsource "base/Kconfig"
rsource "board/shared/Kconfig"
rsource "Kconfig.compile"

config MAIN_THREAD_PRIO
    int "The priority of main thread"
    default 20

config MAIN_THREAD_STACK_SIZE   
    int "The stack size of main thread"
    default 2048
```

## Kconfig.compile
```kconfig
menu "Compile options"

config COMPILER_OPT
    string "Custom compile option"
    default "-Os"

config LTO
    bool "Enable link-time optimize"
    default n

config LINKER_SCRIPT
    string "Linker script file"
    default "linker.ld"
    
endmenu
```

## base/Kconfig
```kconfig
menu "Base library"

config EXPORT_SYMBOL
    bool "Enable symbol export"
    default n

config ASSERT_DISABLE
    bool "Disable Assert"
    default n

config HFSM_SUPPORT
    bool "Enable hierarchical support for FSM"
    default n

config SMALL_MEM_MODEL
    bool "Enable small memory model"
    default n

config FTRACE
    bool "Enable function trace"

config KASAN
    bool "Enable address sanitizer"
    default n

config KASAN_LOAD_NOCHECK
    bool "Disable check load instruction"
    default y

rsource "sys/Kconfig"
rsource "lib/Kconfig"

endmenu
```

## base/sys/Kconfig.crc
```kconfig
# Copyright (c) 2016,2023 Intel Corporation
# SPDX-License-Identifier: Apache-2.0
#
config CRC
	bool "Cyclic redundancy check (CRC) Support"
	help
	  Enable use of CRC.
```

## board/linux_x86/Kconfig
```kconfig
config LINUX_X86
    bool "Linux x86 simualtor"
    select SIMULATOR
    default y
    
```

## board/shared/Kconfig
```kconfig
rsource "kconfig/Kconfig"

menu "Board Shared library"

config CACHE_MANAGEMENT
    bool

config SIMULATOR
    bool

config ARM
    bool

config DCACHE
    bool "Enable cpu data cache"
    select CACHE_MANAGEMENT
    default n

config ICACHE
    bool "Enable cpu instruction cache"
    select CACHE_MANAGEMENT
    default n

config MAX_IRQ_VECTOR
    int "Maximum irq vectors"
    default 150

config ISR_STACK_SIZE
    int "Interrupt stack size"
    default 4096

config CPU_CACHELINE_SIZE
    int "CPU cache line size"
    default 32

config CFILE
    bool "Enable C standard file implement"
    default n

config FILE_DESC_MAX
    int "The maximum number of file descriptor"
    default 3

config KMALLOC_POOL_SIZE
    int "The size of kmalloc byte pool"
    default 2048

config GMALLOC_POOL_SIZE
    int "The size general malloc byte pool"
    default 0

config CPLUSPLUS
    bool "Enable C++ language support"
    default n

config HRTIMER
    bool "Enable high resolution timer"
    default n

config TASK_RUNNER
    bool "Enable task runner queue"
    default y

rsource "cortexm/Kconfig"
endmenu
```

## board/shared/cortexm/Kconfig
```kconfig
menuconfig CORTEXM_LIBRARY
    bool "Enable cortex-m library"
    default n

if CORTEXM_LIBRARY

config CORTEXM_BACKTRACE
    bool "Enable backtrace for cortexM cpu"
    default n

if CORTEXM_BACKTRACE

choice
	prompt "CPU core architecture type"
	default CMB_CPU_ARM_CORTEX_M7

config CMB_CPU_ARM_CORTEX_M7
    bool "Cortex-M7"

config CMB_CPU_ARM_CORTEX_M33
    bool "Cortex-M33"

config CMB_CPU_ARM_CORTEX_M4
    bool "Cortex-M4"

config CMB_CPU_ARM_CORTEX_M3
    bool "Cortex-M3"
endchoice

endif #CORTEXM_BACKTRACE


endif
```

## board/shared/kconfig/Kconfig.dma
```kconfig
# DMA configuration options

# Copyright (c) 2016 Intel Corporation
# SPDX-License-Identifier: Apache-2.0

#
# DMA options
#
menuconfig DMA
	bool "Direct Memory Access (DMA) drivers"

if DMA
config DMA_64BIT
	bool "DMA 64 bit address support"
	help
	  When this option is true, 64 bit source and dest
	  DMA addresses are supported.

endif # DMA
```

## board/stm32/h750_core/Kconfig
```kconfig
config STM32_H750_CORE
    bool "STM32H750 core board"
    select ARM
    default y
    
```

## board/stm32/h750_core/defconfig
```kconfig
# ThreadX
CONFIG_TX_MAX_PRIORITIES=32
CONFIG_TX_MINIMUM_STACK=1024
#CONFIG_TX_TIMER_THREAD_STACK_SIZE=4096
CONFIG_TX_TIMER_THREAD_PRIORITY=10
CONFIG_TX_TIMER_TICKS_PER_SECOND=1000
CONFIG_TX_REACTIVATE_INLINE=y
CONFIG_TX_DISABLE_REDUNDANT_CLEARING=y
CONFIG_TX_INLINE_THREAD_RESUME_SUSPEND=y

# FileX
CONFIG_FILEX=y
CONFIG_FX_FAT_MAP_SIZE=256
CONFIG_FX_MAX_FAT_CACHE=32
CONFIG_FX_DISABLE_ERROR_CHECKING=y

# Command Line
CONFIG_SUBSYS_SDIO=y

# UART
CONFIG_SERIAL=y
CONFIG_UART_USE_RUNTIME_CONFIGURE=y
CONFIG_UART_INTERRUPT_DRIVEN=y

# Shell
CONFIG_SHELL=y
CONFIG_SHELL_DEVICE="uart1"
```

## rtos/Kconfig
```kconfig
menu "RTOS Components"

rsource "configs/Kconfig.threadx"
rsource "configs/Kconfig.filex"
rsource "configs/Kconfig.netxduo"
rsource "configs/Kconfig.usbx"
rsource "configs/Kconfig.levelx"

endmenu
```

## rtos/Kconfig.levelx
```kconfig
menuconfig LEVELX
    bool "Nor/Nand flash wear balance component"
    default n

if LEVELX

config LX_DIRECT_READ
    bool "Reading the NOR memory directly"
    default n
    help
        Defined, this option bypasses the NOR flash driver read routine in favor or reading 
        the NOR memory directly, resulting in a significant performance increase.

config LX_FREE_SECTOR_DATA_VERIFY
    bool "LevelX NOR instance open logic to verify free NOR sectors are all ones"
    default n

config LX_NAND_FLASH_MAX_METADATA_BLOCKS
    int "The maximum of blocks that can be allocated for metadata"
    default 4

config LX_NOR_DISABLE_EXTENDED_CACHE
    bool "Disabled the extended NOR cache"
    default n

config LX_NOR_EXTENDED_CACHE_SIZE
    int "The maximum of sectors that can be cached in a NOR instance"
    depends on !LX_NOR_DISABLE_EXTENDED_CACHE
    default 8

config LX_NOR_SECTOR_MAPPING_CACHE_SIZE
    int "The logical sector mapping cache size"
    default 16
    help
        By default this value is 16 and defines the logical sector mapping cache size.
        Large values improve performance, but cost memory. The minimum size is 8 and all 
        values must be a power of 2.

config LX_THREAD_SAFE_ENABLE
    bool "Enable thread safe"
    default y
    help
        Defined, this makes LevelX thread-safe by using a ThreadX mutex object 
        throughout the API.

config LX_NOR_ENABLE_MAPPING_BITMAP
    bool "Enable logical sector mapping bitmap in extended cache"
    default y

config LX_NOR_ENABLE_OBSOLETE_COUNT_CACHE
    bool "Enable obsolete count cache"
    default n


endif #LEVELX
```

## rtos/Kconfig.threadx
```kconfig
menuconfig THREADX
    bool "Enable ThreadX RTOS"
    default y
    select MULTITHREADING
    help
        For maximum speed, the following should be defined:
            TX_MAX_PRIORITIES                       32
            TX_DISABLE_PREEMPTION_THRESHOLD
            TX_DISABLE_REDUNDANT_CLEARING
            TX_DISABLE_NOTIFY_CALLBACKS
            TX_NOT_INTERRUPTABLE
            TX_TIMER_PROCESS_IN_ISR
            TX_REACTIVATE_INLINE
            TX_DISABLE_STACK_FILLING
            TX_INLINE_THREAD_RESUME_SUSPEND
        For minimum size, the following should be defined:
            TX_MAX_PRIORITIES                       32
            TX_DISABLE_PREEMPTION_THRESHOLD
            TX_DISABLE_REDUNDANT_CLEARING
            TX_DISABLE_NOTIFY_CALLBACKS
            TX_NO_FILEX_POINTER
            TX_NOT_INTERRUPTABLE
            TX_TIMER_PROCESS_IN_ISR

if THREADX
config TX_MAX_PRIORITIES
    int "The maximum priority of thread"
    range 0 1024
    default 32
    help
        The priority must be a multiple of 32

config TX_MINIMUM_STACK
    int "The minimum stack size of thread"
    default 512

config TX_TIMER_TICKS_PER_SECOND
    int "The system timer tick frequency"
    default 1000
    help
        Define the common timer tick reference for use by other middleware components. The default
        value is 10ms (i.e. 100 ticks, defined in tx_api.h), but may be replaced by a port-specific
        version in tx_port.h or here.
        Note: the actual hardware timer value may need to be changed (usually in tx_initialize_low_level).

config TX_NO_FILEX_POINTER
    bool "Disable filex extension for threadx"
    depends on FILE_SYSTEM_FILEXFS
    default n

config TX_TIMER_PROCESS_IN_ISR
    bool "Enable timer callback process in interrupt context"
    default y
    help
        Determine if timer expirations application timers, timeouts, and tx_thread_sleep calls
        should be processed within the a system timer thread or directly in the timer ISR.
        By default, the timer thread is used. When the following is defined, the timer expiration
        processing is done directly from the timer ISR, thereby eliminating the timer thread control
        block, stack, and context switching to activate it.


config TX_TIMER_THREAD_STACK_SIZE
    int "The stack size of timer thread"
    depends on !TX_TIMER_PROCESS_IN_ISR
    default 2048

config TX_TIMER_THREAD_PRIORITY
    int "The priority of timer thread"
    default 8

config TX_REACTIVATE_INLINE
    bool "Inline timer reactive code to improve performance"
    default n
    help
        Determine if in-line timer reactivation should be used within the timer expiration processing.
        By default, this is disabled and a function call is used. When the following is defined,
        reactivating is performed in-line resulting in faster timer processing but slightly larger
        code size.

config TX_ENABLE_STACK_CHECKING
    bool "Enable thread stack overflow check"
    help
        Determine whether or not stack checking is enabled. By default, ThreadX stack checking is
        disabled. When the following is defined, ThreadX thread stack checking is enabled.  If stack
        checking is enabled (TX_ENABLE_STACK_CHECKING is defined), the TX_DISABLE_STACK_FILLING
        define is negated, thereby forcing the stack fill which is necessary for the stack checking
        logic.

config TX_DISABLE_STACK_FILLING
    bool "Disable thread stack filling"
    default n if TX_ENABLE_STACK_CHECKING
    default y
    help
        Determine is stack filling is enabled. By default, ThreadX stack filling is enabled,
        which places an 0xEF pattern in each byte of each thread's stack.  This is used by
        debuggers with ThreadX-awareness and by the ThreadX run-time stack checking feature.

config TX_ENABLE_RANDOM_NUMBER_STACK_FILLING
    bool "Enable thread stack filling by random number"
    depends on TX_ENABLE_STACK_CHECKING
    default n
    help
        Determine if random number is used for stack filling. By default, ThreadX uses a fixed
        pattern for stack filling. When the following is defined, ThreadX uses a random number
        for stack filling. This is effective only when TX_ENABLE_STACK_CHECKING is defined.

config TX_DISABLE_PREEMPTION_THRESHOLD
    bool "Disable thread preemption threshold"
    default n
    help
        Determine if preemption-threshold should be disabled. By default, preemption-threshold is
        enabled. If the application does not use preemption-threshold, it may be disabled to reduce
        code size and improve performance.

config TX_DISABLE_REDUNDANT_CLEARING
    bool "Disable threadx global variable clearing at startup"
    default y
    help
        Determine if global ThreadX variables should be cleared. If the compiler startup code clears
        the .bss section prior to ThreadX running, the define can be used to eliminate unnecessary
        clearing of ThreadX global variables.

config TX_NO_TIMER
    bool "Disable timer component"
    select TX_TIMER_PROCESS_IN_ISR
    default n
    help
        Determine if no timer processing is required. This option will help eliminate the timer
        processing when not needed. The user will also have to comment out the call to
        tx_timer_interrupt, which is typically made from assembly language in
        tx_initialize_low_level. Note: if TX_NO_TIMER is used, the define TX_TIMER_PROCESS_IN_ISR
        must also be used and tx_timer_initialize must be removed from ThreadX library.

config TX_DISABLE_NOTIFY_CALLBACKS
    bool "Disable notify callbacks"
    default n
    help
        Determine if the notify callback option should be disabled. By default, notify callbacks are
        enabled. If the application does not use notify callbacks, they may be disabled to reduce
        code size and improve performance.

config TX_INLINE_THREAD_RESUME_SUSPEND
    bool "Inline thread resume and suspend routine to improve performance"
    default y
    help
        Determine if the tx_thread_resume and tx_thread_suspend services should have their internal
        code in-line. This results in a larger image, but improves the performance of the thread
        resume and suspend services.

config TX_NOT_INTERRUPTABLE
    bool "Enable internal threadX code is non-interruptable"
    default n
    help
        Determine if the internal ThreadX code is non-interruptable. This results in smaller code
        size and less processing overhead, but increases the interrupt lockout time.

config TX_ENABLE_EVENT_TRACE
    bool "Enable trace event logging"
    default n
    help
        Determine if the trace event logging code should be enabled. This causes slight increases in
        code size and overhead, but provides the ability to generate system trace information which
        is available for viewing in TraceX.

config TX_BLOCK_POOL_ENABLE_PERFORMANCE_INFO
    bool "Enable byte pool performance gathering"
    default n
    help
        Determine if byte pool performance gathering is required by the application. When the following is
        defined, ThreadX gathers various byte pool performance information.

config TX_EVENT_FLAGS_ENABLE_PERFORMANCE_INFO
    bool "Enable event flags performance gathering"
    default n
    help
        Determine if event flags performance gathering is required by the application. When the following is
        defined, ThreadX gathers various event flags performance information.

config TX_MUTEX_ENABLE_PERFORMANCE_INFO
    bool "Enable mutex performance gathering"
    default n
    help
        Determine if mutex performance gathering is required by the application. When the following is
        defined, ThreadX gathers various mutex performance information.

config TX_QUEUE_ENABLE_PERFORMANCE_INFO
    bool "Enable queue performance gathering"
    default n
    help
        Determine if queue performance gathering is required by the application. When the following is
        defined, ThreadX gathers various queue performance information.

config TX_SEMAPHORE_ENABLE_PERFORMANCE_INFO
    bool "Enable semaphore performance gathering"
    default n
    help
        Determine if semaphore performance gathering is required by the application. When the following is
        defined, ThreadX gathers various semaphore performance information.

config TX_THREAD_ENABLE_PERFORMANCE_INFO
    bool "Enable thread performance gathering"
    default n
    help
        Determine if thread performance gathering is required by the application. When the following is
        defined, ThreadX gathers various thread performance information.
    
config TX_TIMER_ENABLE_PERFORMANCE_INFO
    bool "Enable timer performance gathering"
    default n
    help
        Determine if timer performance gathering is required by the application. When the following is
        defined, ThreadX gathers various timer performance information.

config TX_BYTE_POOL_MULTIPLE_BLOCK_SEARCH
    int "Override options for byte pool searches of multiple blocks"
    default 20

config TX_BYTE_POOL_DELAY_VALUE
    int "Override options for byte pool search delay to avoid thrashing"
    default 3

endif #THREADX
```
