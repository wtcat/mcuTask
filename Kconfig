## rtos/configs/Kconfig.usbx
```kconfig
menuconfig USBX
    bool "Enable USB protocol stack"
    default n

if USBX

config UX_THREAD_STACK_SIZE
    int "The size of generic usb thread stack"
    default 2048

config UX_HOST_ENUM_THREAD_STACK_SIZE
    int "Host Enum Thread Stack Size"
    default UX_THREAD_STACK_SIZE

config UX_HOST_HCD_THREAD_STACK_SIZE
    int "Host HCD Thread Stack Size"
    default UX_THREAD_STACK_SIZE

config UX_HOST_HNP_POLLING_THREAD_STACK
    int "Host HNP Polling Thread Stack Size"
    default UX_THREAD_STACK_SIZE

config UX_CONTROL_TRANSFER_TIMEOUT
    int "Control transfer timeout value in millisecond"
    default 10000

config UX_NON_CONTROL_TRANSFER_TIMEOUT
    int "Non-Control transfer timeout value in millisecond"
    default 50000

config UX_MAX_CLASSES
    int "The maximum number of classes"
    default 3
    help
        Defined, this value is the maximum number of classes that can be loaded by USBX. This value
        represents the class container and not the number of instances of a class. For instance, if a
        particular implementation of USBX needs the hub class, the printer class, and the storage
        class, then the UX_MAX_CLASSES value can be set to 3 regardless of the number of devices 
        that belong to these classes.

config UX_MAX_SLAVE_CLASS_DRIVER
    int "The maximum number of classes in the device stack"
    default 1

config UX_MAX_SLAVE_INTERFACES
    int "The maximum number of interfaces in the device framework"
    default 16

config UX_MAX_HCD
    int "The maximum number of host controllers"
    default 1
    help
        Defined, this value represents the number of different host controllers available in the system. 
        For USB 1.1 support, this value will usually be 1. For USB 2.0 support, this value can be more 
        than 1. This value represents the number of concurrent host controllers running at the same time.
        If for instance there are two instances of OHCI running, or one EHCI and one OHCI controller
        running, the UX_MAX_HCD should be set to 2.

config UX_MAX_DEVICES
    int "The maximum number of devices"
    default 127
    help
        Defined, this value represents the maximum number of devices that can be attached to the USB.
        Normally, the theoretical maximum number on a single USB is 127 devices. This value can be
        scaled down to conserve memory. Note that this value represents the total number of devices 
        regardless of the number of USB buses in the system.

config UX_MAX_SLAVE_LUN
    int "The maximum number of slave SCSI logical units"
    default 1
    help
        Defined, this value represents the maximum number of SCSI logical units represented in the
        host storage class driver.

config UX_MAX_HOST_LUN
    int "The maximum number of host SCSI logical units"
    default 1
    help
        Defined, this value represents the maximum number of SCSI logical units represented in the
        host storage class driver.

config UX_SLAVE_REQUEST_CONTROL_MAX_LENGTH
    int "The maximum number of bytes received on a control endpoint in the device stack"
    default 256

config UX_DEVICE_ENDPOINT_BUFFER_OWNER
    int "The device endpoint buffer owner"
    range 0 1
    default 0
    help
        Defined, this value represents the endpoint buffer owner.
        0 - The default, endpoint buffer is managed by core stack. Each endpoint takes UX_SLAVE_REQUEST_DATA_MAX_LENGTH bytes.
        1 - Endpoint buffer managed by classes. In this case not all endpoints consume UX_SLAVE_REQUEST_DATA_MAX_LENGTH bytes.

config UX_DEVICE_CLASS_CDC_ACM_ZERO_COPY
    bool "Enables device CDC ACM zero copy for bulk in/out endpoints"
    default n
    help
        Defined, it enables device CDC ACM zero copy for bulk in/out endpoints (write/read).
        Enabled, the endpoint buffer is not allocated in class, application must
        provide the buffer for read/write, and the buffer must meet device controller driver (DCD)
        buffer requirements (e.g., aligned and cache safe).
        It only works if UX_DEVICE_ENDPOINT_BUFFER_OWNER is 1 (endpoint buffer managed by class).

config UX_DEVICE_CLASS_HID_ZERO_COPY
    bool "Enables device HID zero copy"
    default n
    help
        Defined, it enables device HID zero copy and flexible queue support (works if HID owns endpoint buffer).
        Enabled, the internal queue buffer is directly used for transfer, the APIs are kept to keep
        backword compatibility, to AVOID KEEPING BUFFERS IN APPLICATION.
        Flexible queue introduces initialization parameter _event_max_number and _event_max_length,
        so each HID function could have different queue settings.
        _event_max_number could be 2 ~ UX_DEVICE_CLASS_HID_MAX_EVENTS_QUEUE.
        Max of _event_max_length could be UX_DEVICE_CLASS_HID_EVENT_BUFFER_LENGTH.
        If the initialization parameters are invalid (are 0s or exceed upper mentioned definition),
        UX_DEVICE_CLASS_HID_MAX_EVENTS_QUEUE and UX_DEVICE_CLASS_HID_EVENT_BUFFER_LENGTH are used to
        calculate and allocate the queue.

config UX_DEVICE_CLASS_CDC_ECM_ZERO_COPY
    bool "Enables device CDC_ECM zero copy"
    default n
    help
        Defined, it enables device CDC_ECM zero copy support (works if CDC_ECM owns endpoint buffer).
        Enabled, it requires that the NX IP default packet pool is in cache safe area, and buffer max
        size is larger than UX_DEVICE_CLASS_CDC_ECM_ETHERNET_PACKET_SIZE (1536).

config UX_DEVICE_CLASS_RNDIS_ZERO_COPY
    bool "Enables device RNDIS zero copy"
    default n
    help
        Defined, it enables device RNDIS zero copy support (works if RNDIS owns endpoint buffer).
        Enabled, it requires that the NX IP default packet pool is in cache safe area, and buffer max
        size is larger than UX_DEVICE_CLASS_RNDIS_MAX_PACKET_TRANSFER_SIZE (1600).

config UX_DEVICE_CLASS_PRINTER_ZERO_COPY
    bool "enables device printer zero copy support"
    default n
    help
        Defined, it enables zero copy support (works if PRINTER owns endpoint buffer).
        Defined, it enables zero copy for bulk in/out endpoints (write/read). In this case, the endpoint
        buffer is not allocated in class, application must provide the buffer for read/write, and the
        buffer must meet device controller driver (DCD) buffer requirements (e.g., aligned and cache
        safe if buffer is for DMA).

config UX_SLAVE_REQUEST_DATA_MAX_LENGTH
    int "The maximum number of bytes that can be received or transmitted on any endpoint"
    range 2048 16384
    default 2048
    help
        Defined, this value represents the maximum number of bytes that can be received or transmitted
        on any endpoint. This value cannot be less than the maximum packet size of any endpoint. The default
        is 4096 bytes but can be reduced in memory constrained environments. For cd-rom support in the storage
        class, this value cannot be less than 2048.

config UX_DEVICE_ENABLE_GET_STRING_WITH_ZERO_LANGUAGE_ID
    bool "Enables processing of Get String Descriptor requests with zero Language ID"
    default n
    help
        Defined, this enables processing of Get String Descriptor requests with zero Language ID.
        The first language ID in the language ID framwork will be used if the request has a zero
        Language ID.

config UX_SLAVE_CLASS_STORAGE_INCLUDE_MMC
    bool "Enable storage Multi-Media Commands (MMC) for slave class"
    default n

config UX_HOST_CLASS_STORAGE_MEMORY_BUFFER_SIZE
    int "The maximum number of bytes that a storage payload can send/receive"
    default 8192

config UX_HOST_CLASS_STORAGE_THREAD_STACK_SIZE
    int "USBX Mass Storage Thread Stack Size"
    default UX_THREAD_STACK_SIZE

config UX_MAX_ED
    int "The maximum number of Ed"
    default 80

config UX_MAX_TD
    int "The maximum number of regular TDs"
    default 128

config UX_MAX_ISO_TD
    int "The maximum number of Isochronous TDs"
    default 1

config UX_HOST_CLASS_HID_DECOMPRESSION_BUFFER
    int "The maximum size of the HID decompressed buffer"
    default 4096
    help
        This cannot be determined in advance so we allocate a big block, usually 4K but 
        for simple HID devices like keyboard and mouse it can be reduced a lot.

config UX_HOST_CLASS_HID_USAGES
    int "The maximum number of HID usages for a HID device"
    default 2048
    help
        Default is 2048 but for simple HID devices like keyboard and mouse it can be reduced a lot.

config UX_HOST_CLASS_HID_KEYBOARD_EVENTS_KEY_CHANGES_MODE
    bool "Enable host class hid keyboard events key changes mode"
    default n
    help
        By default, each key in each HID report from the device is reported by ux_host_class_hid_keyboard_key_get 
        (a HID report from the device is received whenever there is a change in a key state i.e. when a key is pressed
        or released. The report contains every key that is down). There are limitations to this method such as not being
        able to determine when a key has been released.

config UX_HOST_CLASS_HID_KEYBOARD_EVENTS_KEY_CHANGES_MODE_REPORT_KEY_DOWN_ONLY
    bool "Only report key pressed/down changes"
    depends on UX_HOST_CLASS_HID_KEYBOARD_EVENTS_KEY_CHANGES_MODE
    default n
    help
        Defined, this value causes ux_host_class_hid_keyboard_key_get to only report key pressed/down changes;
        key released/up changes are not reported.

config UX_HOST_CLASS_HID_KEYBOARD_EVENTS_KEY_CHANGES_MODE_REPORT_LOCK_KEYS
    bool "Report lock key (CapsLock/NumLock/ScrollLock) changes"
    depends on UX_HOST_CLASS_HID_KEYBOARD_EVENTS_KEY_CHANGES_MODE
    default n
    help
        Defined, this value causes ux_host_class_hid_keyboard_key_get to report lock key 
        (CapsLock/NumLock/ScrollLock) changes.

config UX_HOST_CLASS_HID_KEYBOARD_EVENTS_KEY_CHANGES_MODE_REPORT_MODIFIER_KEYS
    bool "Report modifier key (Ctrl/Alt/Shift/GUI) changes"
    depends on UX_HOST_CLASS_HID_KEYBOARD_EVENTS_KEY_CHANGES_MODE
    default n
    help
        Defined, this value causes ux_host_class_hid_keyboard_key_get to report modifier key 
        (Ctrl/Alt/Shift/GUI) changes.

config UX_HOST_CLASS_STORAGE_MAX_MEDIA
    int "The maximum number of media for the host storage class"
    default 8
    help
        Default is 8 but for memory constrained resource systems this can ne reduced to 1.

config UX_HOST_CLASS_STORAGE_INCLUDE_LEGACY_PROTOCOL_SUPPORT
    bool "Enable legacy protocol support for host storage"
    default n
    help
        Defined, this value includes code to handle storage devices that use the CB
        or CBI protocol (such as floppy disks). It is off by default because these 
        protocols are obsolete, being superseded by the Bulk Only Transport (BOT) protocol
        which virtually all modern storage devices use.

config UX_ENFORCE_SAFE_ALIGNMENT
    bool "Force memory safe alignment that allocate from byte pool"
    default n
    help
        Defined, this value forces the memory allocation scheme to enforce alignment
        of memory with the UX_SAFE_ALIGN field.

config UX_DEVICE_CLASS_CDC_ECM_NX_PKPOOL_ENTRIES
    int "The number of packets in the CDC_ECM device class"
    default 4

config UX_HOST_CLASS_CDC_ECM_NX_PKPOOL_ENTRIES
    int "The number of packets in the CDC_ECM host class"
    default 16
 
config UX_HOST_CLASS_CDC_ECM_PACKET_POOL_WAIT
    int "The number of milliseconds to wait for packet allocation in the CDC_ECM host class"
    default 10
    help
        Defined, this value represents the number of milliseconds to wait for packet
        allocation until invoking the application's error callback and retrying.
        The default is 1000 milliseconds.

config UX_HOST_CLASS_CDC_ECM_PACKET_POOL_INSTANCE_WAIT
    int "The number of milliseconds to wait for packet pool availability in CDC_ECM host class"
    default 10
    help
        Defined, this value represents the number of milliseconds to wait for packet
        pool availability checking loop. The default is 100 milliseconds.

config UX_HOST_CLASS_CDC_ECM_USE_PACKET_POOL_FROM_NETX
    bool "Enables HOST CDC ECM class to use the packet pool from NetX instance"
    default n
    help
        It's deprecated, packet pool from NetX instance is always used now.

config UX_DEVICE_CLASS_CDC_ECM_PACKET_POOL_WAIT
    int "The number of milliseconds to wait for packet allocation in CDC_ECM device class"
    default 10
    help
        Defined, this value represents the number of milliseconds to wait for packet
        allocation until invoking the application's error callback and retrying.

config UX_DEVICE_CLASS_HID_EVENT_BUFFER_LENGTH
    int "The the maximum length of HID reports on the device"
    default 64

config UX_DEVICE_CLASS_HID_MAX_EVENTS_QUEUE
    int "The maximum number of HID events/reports that can be queued at once"
    default 8

config UX_DEVICE_CLASS_DFU_UPLOAD_DISABLE
    bool "Disable DFU_UPLOAD support"
    default n

config UX_DEVICE_CLASS_DFU_ERROR_GET_ENABLE
    bool "Enable DFU_GETSTATUS and DFU_GETSTATE in dfuERROR"
    default n

config UX_DEVICE_CLASS_DFU_STATUS_MODE
    int "DFU status mode in device class"
    range 0 1
    default 0
    help
        Defined, this macro will change status mode.
        0 - simple mode,
            status is queried from application in dfuDNLOAD-SYNC and dfuMANIFEST-SYNC state,
            no bwPollTimeout.
        1 - status is queried from application once requested,
            b0-3 : media status
            b4-7 : bStatus
            b8-31: bwPollTimeout
            bwPollTimeout supported.

config UX_DEVICE_CLASS_DFU_STATUS_POLLTIMEOUT
    int "The default DFU status bwPollTimeout"
    range 0 16777215
    default 1
    help
        Defined, this value represents the default DFU status bwPollTimeout.
        The value is 3 bytes long (max 0xFFFFFFu).
        By default the bwPollTimeout is 1 (means 1ms).

config UX_DEVICE_CLASS_DFU_CUSTOM_REQUEST_ENABLE
    bool "Enable custom request process callback"
    default n

config UX_DEVICE_CLASS_CDC_ACM_TRANSMISSION_DISABLE
    bool "Disables CDC ACM non-blocking transmission support"
    default n

config UX_DEVICE_CLASS_HID_INTERRUPT_OUT_SUPPORT
    bool "Device HID interrupt OUT transfer is supported"
    default n

config UX_DEVICE_CLASS_AUDIO_FEEDBACK_SUPPORT
    bool "Enables device audio feedback endpoint support"
    default n

config UX_DEVICE_CLASS_AUDIO_FEEDBACK_ENDPOINT_BUFFER_SIZE
    int "Feedback endpoint buffer size"
    depends on UX_DEVICE_ENDPOINT_BUFFER_OWNER = 1
    default 8
    help
        It should be larger than feedback endpoint max packet size in framework.

config UX_DEVICE_CLASS_CDC_ACM_WRITE_AUTO_ZLP
    bool "Class CDC ACM write is pending ZLP automatically (complete transfer) after buffer is sent"

config UX_DEVICE_CLASS_PRINTER_WRITE_AUTO_ZLP
    bool "Class PRINTER write is pending ZLP automatically (complete transfer) after buffer is sent"

config UX_DEVICE_CLASS_AUDIO_INTERRUPT_SUPPORT
    bool "Enables device audio interrupt endpoint support"
    default n

config UX_DEVICE_BIDIRECTIONAL_ENDPOINT_SUPPORT
    bool "Enables device bi-directional-endpoint support"
    default n

config UX_DEVICE_ALTERNATE_SETTING_SUPPORT_DISABLE
    bool "Disables device interface alternate setting support"
    default n

config UX_DEVICE_INITIALIZE_FRAMEWORK_SCAN_DISABLE
    bool "Disables device framework scan"
    default n

config UX_MAX_DEVICE_ENDPOINTS
    int "The maximum number of endpoints (except EP0) activated at the same time"
    depends on UX_DEVICE_INITIALIZE_FRAMEWORK_SCAN_DISABLE
    default 2

config UX_MAX_DEVICE_INTERFACES
    int "The maximum number of interfaces activated at the same time"
    depends on UX_DEVICE_INITIALIZE_FRAMEWORK_SCAN_DISABLE
    default 1

config UX_PIMA_WITH_MTP_SUPPORT
    bool "Enables device/host PIMA MTP support"
    default n

config UX_HOST_DEVICE_CLASS_CODE_VALIDATION_ENABLE
    bool "Enables host device class code validation"
    default n

config UX_HOST_CLASS_HID_INTERRUPT_OUT_SUPPORT
    bool "Enable host HID interrupt OUT transfer support"
    default n

config UX_HOST_CLASS_HID_REPORT_TRANSFER_TIMEOUT
    int "HID report transfer timeout value in millisecond"
    default 10000

config UX_HOST_CLASS_AUDIO_2_SUPPORT
    bool "Enable host audio UAC 2.0 support"
    default n

config UX_HOST_CLASS_AUDIO_FEEDBACK_SUPPORT
    bool "Enable host audio optional feedback endpoint support"
    default n

config UX_HOST_CLASS_AUDIO_INTERRUPT_SUPPORT
    bool "Enable host audio optional interrupt endpoint support"
    default n

config UX_HOST_STACK_CONFIGURATION_INSTANCE_CREATE_CONTROL
    int "Host stack configuration instance create control"
    range 0 1
    default 1
    help
        Defined, this value controls host configuration instance creation, include all
        interfaces and endpoints physical resources.
        Possible settings:
            UX_HOST_STACK_CONFIGURATION_INSTANCE_CREATE_ALL (0) - The default, create all inside configuration.
            UX_HOST_STACK_CONFIGURATION_INSTANCE_CREATE_OWNED (1) - Create things owned by class driver.
        Not defined, default setting is applied.

config UX_NAME_REFERENCED_BY_POINTER
    bool "UX name will use pointer but not a array"
    default n
    help
        Defined, the _name in structs are referenced by pointer instead of by contents.
        By default the _name is an array of string that saves characters, the contents are compared to confirm match.
        If referenced by pointer the address pointer to const string is saved, the pointers are compared to confirm match.

choice
    prompt "UX USB stack mode"

config UX_HOST_SIDE_ONLY
    bool "Only enable host stack mode"

config UX_DEVICE_SIDE_ONLY
    bool "Only enable device stack mode"

config UX_OTG_SUPPORT
    bool "Enable OTG mode (host && device)"

endchoice

config UX_HOST_CLASS_STORAGE_NO_FILEX
    bool "Disable host storage support for FILEX"
    default y if !FILEX
    default n

config UX_HOST_CLASS_STORAGE_MAX_TRANSFER_SIZE
    int "The maximum size of single transfers for the SCSI data phase"
    default 1024

config UX_DEBUG_LOG_SIZE
    int "The size of the log pool"
    default 16384

config UX_ENABLE_ASSERT
    bool "Enable Assert"
    default y

config UX_ENABLE_ERROR_CHECKING
    bool "Enable usb stack error checking"
    default y

endif #USBX
```
